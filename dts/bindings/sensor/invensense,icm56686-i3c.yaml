## dts/bindings/sensor/invensense,icm56686-i3c.yaml
```yaml
# # Copyright (c) 2025 Croxel Inc.
# # SPDX-License-Identifier: Apache-2.0

description: |
    ICM56686 High-precision 6-axis motion tracking device
    When setting the accel-pm, accel-range, accel-odr, gyro-pm, gyro-range,
    gyro-odr properties in a .dts or .dtsi file you may include icm566xx.h
    and use the macros defined there.

    Example:
    #include <zephyr/dt-bindings/sensor/icm566xx.h>

    &i3c1 {
      ...

      icm56686: icm56686@680000046a00000011 {
        ...

        accel-pwr-mode = <ICM566XX_DT_ACCEL_LN>;
        accel-fs = <ICM566XX_DT_ACCEL_FS_32>;
        accel-odr = <ICM566XX_DT_ACCEL_ODR_800>;
        gyro-pwr-mode= <ICM566XX_DT_GYRO_LN>;
        gyro-fs = <ICM566XX_DT_GYRO_FS_4000>;
        gyro-odr = <ICM566XX_DT_GYRO_ODR_800>;
      };
    };

compatible: "invensense,icm56686"

properties:
  accel-fs:
    type: int
    default: 0
    description: |
      Specify the accelerometer range in g.
      Default is power-up configuration.
    enum:
      - 0 # ICM566XX_DT_ACCEL_FS_32
      - 1 # ICM566XX_DT_ACCEL_FS_16
      - 2 # ICM566XX_DT_ACCEL_FS_8
      - 3 # ICM566XX_DT_ACCEL_FS_4
      - 4 # ICM566XX_DT_ACCEL_FS_2

  gyro-fs:
    type: int
    default: 0
    description: |
      Specify the gyro range in degrees per second.
      Default is power-up configuration.
    enum:
      - 0 # ICM566XX_DT_GYRO_FS_4000
      - 1 # ICM566XX_DT_GYRO_FS_2000
      - 2 # ICM566XX_DT_GYRO_FS_1000
      - 3 # ICM566XX_DT_GYRO_FS_500
      - 4 # ICM566XX_DT_GYRO_FS_250
      - 5 # ICM566XX_DT_GYRO_FS_125
      - 6 # ICM566XX_DT_GYRO_FS_62_5
      - 7 # ICM566XX_DT_GYRO_FS_31_25
      - 8 # ICM566XX_DT_GYRO_FS_15_625

include: ["i3c-device.yaml", "invensense,icm566xx-common.yaml"]
```

## dts/bindings/sensor/invensense,ictx53xx-i2c.yaml
```yaml
# Copyright (c) 2024 TDK Invensense
# SPDX-License-Identifier: Apache-2.0

description: ICTx53xx High Accuracy TMR Magnetometer Sensor

compatible: "invensense,ictx53xx"

include: [sensor-device.yaml, i2c-device.yaml]
```
