## samples/sensor/icp201xx/pressure_interrupt/sample.yaml
```yaml
sample:
  name: ICP201XX Sensor pressure interrupt
tests:
  sample.sensor.icp201xx:
    build_only: true
    depends_on: i2c
    tags: sensors
    integration_platforms:
      - nrf52dk/nrf52832
    platform_exclude:
      - tdk_robokit1
```

## samples/sensor/icp201xx/sample.yaml
```yaml
sample:
  name: Pressure sensor interrupt
tests:
  sample.sensor.icp201xx:
    build_only: true
    tags: sensors
    filter: dt_alias_exists("pressure_sensor")
    integration_platforms:
      - nrf52dk/nrf52832
    platform_exclude:
      - tdk_robokit1
```

## samples/sensor/ict1531x/sample.yaml
```yaml
sample:
  name: ICT1531X Sensor data sample
tests:
  sample.sensor.ict1531x:
    build_only: true
    depends_on: i2c
    tags: sensors
    integration_platforms:
      - nrf52dk/nrf52832
    platform_exclude:
      - tdk_robokit1
```

## samples/sensor/pressure_polling/sample.yaml
```yaml
sample:
  name: Pressure polling sample
tests:
  sample.sensor.pressure_sensor:
    build_only: true
    depends_on: i2c
    tags: sensors
    filter: dt_alias_exists("pressure_sensor")
    integration_platforms:
      - nrf52dk/nrf52832
    platform_exclude:
      - tdk_robokit1
```

## samples/sensor/tdk_apex/Kconfig
```kconfig
# Copyright (c) 2024, TDK Invensense
# SPDX-License-Identifier: Apache-2.0

# Enable trigger to get APEX sensor data

config ICM42670_TRIGGER
	default y

choice ICM42670_TRIGGER_MODE
	default ICM42670_TRIGGER_OWN_THREAD
endchoice

# Enable APEX features support for the IMU device selected

config ICM42670_APEX
	default y

# Choose between :
# TDK_APEX_PEDOMETER, TDK_APEX_TILT, TDK_APEX_SMD or TDK_APEX_WOM

choice APEX_FEATURES
	default TDK_APEX_PEDOMETER
endchoice

source "Kconfig.zephyr"
```

## samples/sensor/tdk_apex/sample.yaml
```yaml
sample:
  name: TDK Sensor APEX sample
tests:
  sample.sensor.icm42670.apex:
    build_only: true
    tags: sensors
    integration_platforms:
      - nrf52dk/nrf52832
```
