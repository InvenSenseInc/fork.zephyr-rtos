## dts/bindings/sensor/invensense,icm42670-i2c.yaml
```yaml
# Copyright (c) 2024 TDK Invensense
# Copyright (c) 2022 Esco Medical ApS
# Copyright (c) 2020 TDK Invensense
# SPDX-License-Identifier: Apache-2.0

description: ICM42670 integrated environmental sensor

compatible: "invensense,icm42670"

include: [sensor-device.yaml, i2c-device.yaml]

properties:
  int-gpios:
    type: phandle-array
    required: true
    description: |
      The INT signal default configuration is active-high.  The
      property value should ensure the flags properly describe the
      signal that is presented to the driver.

  power-mode:
    type: string
    default: "low noise"
    description: |
      Default power mode.
      Low power mode is allowed for accelerometer sensor only from 1.5625Hz to 400Hz
    enum:
      - "low noise"
      - "low power"

  accel-hz:
    type: int
    default: 100
    description: |
      Default frequency of accelerometer. (Unit - Hz)
      Maps to ACCEL_ODR field in ACCEL_CONFIG0 setting
    enum:
      - 0
      - 1600
      - 800
      - 400
      - 200
      - 100
      - 50
      - 25
      - 12
      - 6
      - 3
      - 1

  accel-fs:
    type: int
    default: 16
    description: |
      Default full scale of accelerometer. (Unit - g)
      Maps to ACCEL_UI_FS_SEL field in ACCEL_CONFIG0 setting
    enum:
      - 16
      - 8
      - 4
      - 2

  accel-avg:
    type: int
    default: 32
    description: |
      Default averaging filter setting to create accelerometer output
      in accelerometer low power mode.
      Maps to ACCEL_UI_AVG field in ACCEL_CONFIG1 setting
    enum:
      - 2
      - 4
      - 8
      - 16
      - 32
      - 64

  accel-filt-bw:
    type: int
    default: 180
    description: |
      Default accel low pass filter bandwidth frequency
      Maps to ACCEL_UI_FILT_BW field in ACCEL_CONFIG1 setting
    enum:
      - 0
      - 180
      - 121
      - 73
      - 53
      - 34
      - 25
      - 16

  gyro-hz:
    type: int
    default: 100
    description: |
      Default frequency of gyroscope. (Unit - Hz)
      Maps to GYRO_ODR field in GYRO_CONFIG0 setting
    enum:
      - 0
      - 1600
      - 800
      - 400
      - 200
      - 100
      - 50
      - 25
      - 12

  gyro-fs:
    type: int
    default: 2000
    description: |
      Default full scale of gyroscope. (Unit - DPS)
      Maps to GYRO_UI_FS_SEL field in GYRO_CONFIG0 setting
    enum:
      - 2000
      - 1000
      - 500
      - 250

  gyro-filt-bw:
    type: int
    default: 180
    description: |
      Default gyro low pass filter bandwidth frequency
      Maps to GYRO_UI_FILT_BW field in GYRO_CONFIG1 setting
    enum:
      - 0
      - 180
      - 121
      - 73
      - 53
      - 34
      - 25
      - 16
```

## dts/bindings/sensor/invensense,icm42x7x-i2c.yaml
```yaml
# Copyright (c) 2024 TDK Invensense
# SPDX-License-Identifier: Apache-2.0

description: ICM42X7X integrated environmental sensor, accessed through I2C bus

compatible: "invensense,icm42x7x"

include: ["invensense,icm42x7x-common.yaml", "i2c-device.yaml"]
```

## dts/bindings/sensor/invensense,icm42x7x-spi.yaml
```yaml
# Copyright (c) 2024 TDK Invensense
# Copyright (c) 2022 Esco Medical ApS
# Copyright (c) 2020 TDK Invensense
# SPDX-License-Identifier: Apache-2.0

description: ICM42X7X integrated environmental sensor, accessed through SPI bus

compatible: "invensense,icm42x7x"

include: ["invensense,icm42x7x-common.yaml", "spi-device.yaml"]
```

## dts/bindings/sensor/invensense,icm45686.yaml
```yaml
# Copyright (c) 2025 TDK Invensense
# SPDX-License-Identifier: Apache-2.0

description: ICM-45686 motion tracking device

compatible: "invensense,icm45686"

include: [sensor-device.yaml, spi-device.yaml]

properties:
  int-gpios:
    type: phandle-array
    description: |
      The INT signal default configuration is active-high. The
      property value should ensure the flags properly describe the
      signal that is presented to the driver.

  accel-hz:
    type: int
    default: 25
    description: |
      Default frequency of accelerometer. (Unit - Hz)
      Maps to ACCEL_ODR field in ACCEL_CONFIG0 setting
      Power-on reset value is 800.
    enum:
      - 0
      - 6400
      - 3200
      - 1600
      - 800
      - 400
      - 200
      - 100
      - 50
      - 25
      - 12
      - 6
      - 3
      - 1

  power-mode:
    type: string
    default: "low-power"
    description: |
      Power mode.
      Low power mode is allowed for accelerometer sensor only from
      1.5625Hz to 400Hz.
      The default is chosen to support both accelerometer and
      gyroscope sensors.
    enum:
      - "low-noise"
      - "low-power"

  accel-fs:
    type: int
    default: 16
    description: |
      Default full scale of accelerometer. (Unit - g)
      Maps to ACCEL_FS_SEL field in ACCEL_CONFIG0 setting
      Power-on reset value is 16
    enum:
      - 32
      - 16
      - 8
      - 4
      - 2

  accel-avg:
    type: int
    default: 32
    description: |
      Averaging filter setting to create accelerometer output
      in accelerometer low power mode.
      Maps to ACCEL_UI_AVG field in ACCEL_CONFIG1 setting.
      The default corresponds to the reset value of the register field.
    enum:
      - 1
      - 2
      - 4
      - 5
      - 7
      - 8
      - 10
      - 11
      - 16
      - 18
      - 20
      - 32
      - 64

  accel-filt-bw-hz:
    type: int
    default: 128
    description: |
      Accelerometer low pass filter bandwidth frequency (Unit - Hz).
      Maps to ACCEL_UI_FILT_BW field in ACCEL_CONFIG1 setting.
      The default corresponds to the reset value of the register field.
    enum:
      - 0
      - 4
      - 8
      - 16
      - 32
      - 64
      - 128

  gyro-hz:
    type: int
    default: 25
    description: |
      Default frequency of gyroscope. (Unit - Hz)
      Maps to GYRO_ODR field in GYRO_CONFIG0 setting
    enum:
      - 0
      - 6400
      - 3200
      - 1600
      - 800
      - 400
      - 200
      - 100
      - 50
      - 25
      - 12
      - 6
      - 3
      - 1

  gyro-fs:
    type: int
    default: 2000
    description: |
      Default full scale of gyroscope. (Unit - DPS)
      Maps to GYRO_UI_FS_SEL field in GYRO_CONFIG0 setting
    enum:
      - 4000
      - 2000
      - 1000
      - 500
      - 250
      - 125
      - 62
      - 31
      - 15

  gyro-filt-bw-hz:
    type: int
    default: 128
    description: |
      Default gyro low pass filter bandwidth frequency
      Maps to GYRO_UI_FILT_BW field in GYRO_CONFIG1 setting
    enum:
      - 0
      - 4
      - 8
      - 16
      - 32
      - 64
      - 128

  apex:
    type: string
    default: "none"
    description: |
      APEX (Advanced Pedometer and Event Detection) features. It consists of:
      * Pedometer: Tracks step count, and provide details such as the cadence and
                   the estimated activity type (Walk, Run, Unknown).
      * Tilt Detection: Detects the Tilt when tilting the board with an angle of
                        30 degrees or more held for 4 seconds.
      * Wake on Motion (WoM): Detects motion per axis exceeding 195 mg threshold.
      * Significant Motion Detector (SMD): Detects when the user has moved significantly.
    enum:
      - "none"
      - "pedometer"
      - "tilt"
      - "smd"
      - "wom"
```

## dts/bindings/sensor/invensense,icp201xx-spi.yaml
```yaml
# Copyright (c) 2024 TDK Invensense
# SPDX-License-Identifier: Apache-2.0

description: ICP201xx High Accuracy, Low Power, Barometric Pressure and Temperature Sensor IC

compatible: "invensense,icp201xx"

include: [sensor-device.yaml, spi-device.yaml]

properties:
  int-gpios:
    type: phandle-array
    description: |
      The INT signal default configuration is active-high. The
      property value should ensure the flags properly describe the
      signal that is presented to the driver.

  op-mode:
    type: int
    required: false
    default: 0
    description: |
      Default mode for sensor.
      Maps to icp201xx_op_mode_t
    enum:
      - 0
      - 1
      - 2
      - 3
      - 4

  drive-strength:
    type: int
    required: false
    default: 3
    description: |
      IO device strength register value.
    enum:
      - 0
      - 1
      - 2
      - 3
      - 4
      - 5
      - 6
      - 7
```

## dts/bindings/sensor/invensense,icp201xx.yaml
```yaml
# Copyright (c) 2024 TDK Invensense
# SPDX-License-Identifier: Apache-2.0

description: ICP201xx High Accuracy, Low Power, Barometric Pressure and Temperature Sensor IC

compatible: "invensense,icp201xx"

include: [sensor-device.yaml, i2c-device.yaml]

properties:
  int-gpios:
    type: phandle-array
    description: |
      The INT signal default configuration is active-high. The
      property value should ensure the flags properly describe the
      signal that is presented to the driver.
```

## dts/bindings/sensor/invensense,ict1531x.yaml
```yaml
# Copyright (c) 2024 TDK Invensense
# SPDX-License-Identifier: Apache-2.0

description: ICT1531x high precision 3-axis electronic magnetometer sensor IC.

compatible: "invensense,ict1531x"

include: [sensor-device.yaml, i2c-device.yaml]
```

## dts/bindings/sensor/tdk_invensense,icm42670S-spi.yaml
```yaml
# Copyright (c) 2019, Linaro Limited
# SPDX-License-Identifier: Apache-2.0

description: ICM42670S integrated environmental sensor

compatible: "invensense,icm42670S"

include: [sensor-device.yaml, spi-device.yaml]
```

## modules/hal_tdk/Kconfig
```kconfig
# Copyright (c) 2024 TDK Invensense
# SPDX-License-Identifier: Apache-2.0

config ZEPHYR_HAL_TDK_MODULE
	bool "TDK HAL sensor drivers"
	help
	  Use the TDK HAL

config USE_EMD_ICM42670
	bool "ICM4267x High Performance 6-Axis MotionTracking IMU"
	depends on ZEPHYR_HAL_TDK_MODULE
	depends on DT_HAS_INVENSENSE_ICM42670P_ENABLED \
		|| DT_HAS_INVENSENSE_ICM42670S_ENABLED

config USE_EMD_ICM42370
	bool "ICM42370P High Performance 3-Axis MotionTracking Accelerometer"
	depends on ZEPHYR_HAL_TDK_MODULE
	depends on DT_HAS_INVENSENSE_ICM42370P_ENABLED
```

## samples/sensor/icm42670/apex/Kconfig
```kconfig
# Copyright (c) 2020, TDK Invensense
# SPDX-License-Identifier: Apache-2.0

# Enable APEX features support and choose between : 
# ICM42670_APEX_PEDOMETER, ICM42670_APEX_TILT, ICM42670_APEX_SMD or ICM42670_APEX_WOM

config ICM42670_APEX
	default y

choice APEX_FEATURES
    default ICM42670_APEX_PEDOMETER
endchoice

source "Kconfig.zephyr"
```

## samples/sensor/icm42670/apex/sample.yaml
```yaml
sample:
  name: ICM42670 Sensor APEX sample
tests:
  sample.sensor.icm42670:
    build_only: true
    tags: sensors
    integration_platforms:
      - nrf52dk_nrf52832
```

## samples/sensor/icm42670S/data_stream/sample.yaml
```yaml
sample:
  name: ICM42670S Sensor data stream sample
tests:
  sample.sensor.icm42670S:
    build_only: true
    tags: sensors
    integration_platforms:
      - nrf52dk_nrf52832
```

## samples/sensor/icp10125/sample.yaml
```yaml
sample:
  name: ICP10125 Sensor data sample
tests:
  sample.sensor.icp10125
    harness: console
    tags: sensors
    integration_platforms:
      - arduino_zero
      - nrf52dk_nrf52832
```

## samples/sensor/icp101xx/sample.yaml
```yaml
sample:
  name: ICP101XX Sensor data sample
tests:
  sample.sensor.icp101xx
    harness: console
    tags: sensors
    integration_platforms:
      - arduino_zero
      - nrf52dk_nrf52832
```

## samples/sensor/icp201xx/polling/sample.yaml
```yaml
sample:
  name: ICP201XX Sensor polling
tests:
  sample.sensor.icp201xx:
    build_only: true
    depends_on: i2c
    tags: sensors
    integration_platforms:
      - nrf52dk/nrf52832
    platform_exclude:
      - tdk_robokit1
```

## samples/sensor/icp201xx/pressure_change_interrupt/sample.yaml
```yaml
sample:
  name: ICP201XX Sensor pressure change
tests:
  sample.sensor.icp201xx.pressure_change:
    build_only: true
    depends_on: i2c
    tags: sensors
    integration_platforms:
      - nrf52dk/nrf52832
    platform_exclude:
      - tdk_robokit1
```
