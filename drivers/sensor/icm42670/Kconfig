## drivers/sensor/icm42670/Kconfig
```kconfig
# ICM42670-P ICM42670-S Six-Axis Motion Tracking device configuration options
#
# Copyright (c) 2023 TDK Invensense
# SPDX-License-Identifier: Apache-2.0

menuconfig ICM42670
	bool "ICM42670 6-Axis Motion Tracking Device"
	default y
	depends on DT_HAS_INVENSENSE_ICM42670_ENABLED
	select I2C if $(dt_compat_on_bus,$(DT_COMPAT_INVENSENSE_ICM42670),i2c)
	select SPI if $(dt_compat_on_bus,$(DT_COMPAT_INVENSENSE_ICM42670),spi)
	help
	  Enable driver for ICM42670 I2C-based or SPI-based Six-Axis Motion Tracking device.

if ICM42670

config ICM42670_APEX
	bool "ICM42670 APEX features"
	default n

choice APEX_FEATURES
	prompt "ICM42670 APEX features"
	depends on ICM42670_APEX
	default ICM42670_APEX_PEDOMETER
	help
	  Select APEX feature for ICM42670 sensor.
config ICM42670_APEX_PEDOMETER
	bool "Pedometer: Tracks step count"
config ICM42670_APEX_TILT
	bool "Tilt Detection: Detect the Tilt angle exceeds 35 degrees"
config ICM42670_APEX_SMD
	bool "Significant Motion Detector (SMD): Detects significant motion based on accelerometer data"
config ICM42670_APEX_WOM
	bool "Wake on Motion (WoM): Detects motion when accelerometer samples exceed a programmable threshold"
endchoice

menuconfig ICM42670S_AML
	bool "ICM42670 Air Motion Library (AML)"
	default n

if ICM42670S_AML

config ICM42670S_AML_POINTING
	bool "Delta values for pointing"
config ICM42670S_AML_GESTURES
	bool "Orientation of the remote and detected swipes"
config ICM42670S_AML_GYR_OFFSET
	bool "Computed 3-axis raw gyroscope offsets"
config ICM42670S_AML_QUATERNION
	bool "Computed W, X, Y and Z quaternion coefficients"

endif # ICM42670S_AML

choice ICM42670_TRIGGER_MODE
	prompt "Trigger mode"
	default ICM42670_TRIGGER_OWN_THREAD
	help
	  Specify the type of triggering to be used by the driver.

config ICM42670_TRIGGER_NONE
	bool "No trigger"

config ICM42670_TRIGGER_GLOBAL_THREAD
	bool "Use global thread"
	depends on GPIO
	select ICM42670_TRIGGER

config ICM42670_TRIGGER_OWN_THREAD
	bool "Use own thread"
	depends on GPIO
	select ICM42670_TRIGGER
endchoice

config ICM42670_TRIGGER
	bool

config ICM42670_THREAD_PRIORITY
	int "Thread priority"
	default 10
	help
	  Priority of thread used by the driver to handle interrupts.

config ICM42670_THREAD_STACK_SIZE
	int "Thread stack size"
	default 1024
	help
	  Stack size of thread used by the driver to handle interrupts.

endif # ICM42670
```

## drivers/sensor/icm42670S/Kconfig
```kconfig
# ICM42670-P ICM42670-S Six-Axis Motion Tracking device configuration options
#
# Copyright (c) 2023 TDK Invensense
# SPDX-License-Identifier: Apache-2.0

menuconfig ICM42670S
	bool "ICM42670S 6-Axis Motion Tracking Device"
	default y
	depends on DT_HAS_INVENSENSE_ICM42670S_ENABLED
	select I2C if $(dt_compat_on_bus,$(DT_COMPAT_INVENSENSE_ICM42670S),i2c)
	select SPI if $(dt_compat_on_bus,$(DT_COMPAT_INVENSENSE_ICM42670S),spi)
	help
	  Enable driver for ICM42670S I2C-based or SPI-based Six-Axis Motion Tracking device.

if ICM42670S

config ICM42670S_APEX
	bool "ICM42670S APEX features"
	default n

choice APEX_FEATURES
	prompt "ICM42670S APEX features"
	depends on ICM42670S_APEX
	default ICM42670S_APEX_PEDOMETER
	help
	  Select APEX feature for ICM42670S sensor.
config ICM42670S_APEX_PEDOMETER
	bool "Pedometer: Tracks step count"
config ICM42670S_APEX_TILT
	bool "Tilt Detection: Detect the Tilt angle exceeds 35 degrees"
config ICM42670S_APEX_SMD
	bool "Significant Motion Detector (SMD): Detects significant motion based on accelerometer data"
config ICM42670S_APEX_WOM
	bool "Wake on Motion (WoM): Detects motion when accelerometer samples exceed a programmable threshold"
endchoice

menuconfig ICM42670S_AML
	bool "ICM42670S Air Motion Library (AML)"
	default n

if ICM42670S_AML

config ICM42670S_AML_POINTING
	bool "Delta values for pointing"
config ICM42670S_AML_GESTURES
	bool "Orientation of the remote and detected swipes"
config ICM42670S_AML_GYR_OFFSET
	bool "Computed 3-axis raw gyroscope offsets"
config ICM42670S_AML_QUATERNION
	bool "Computed W, X, Y and Z quaternion coefficients"

endif # ICM42670S_AML

choice ICM42670S_TRIGGER_MODE
	prompt "Trigger mode"
	default ICM42670S_TRIGGER_OWN_THREAD
	help
	  Specify the type of triggering to be used by the driver.

config ICM42670S_TRIGGER_NONE
	bool "No trigger"

config ICM42670S_TRIGGER_GLOBAL_THREAD
	bool "Use global thread"
	depends on GPIO
	select ICM42670S_TRIGGER

config ICM42670S_TRIGGER_OWN_THREAD
	bool "Use own thread"
	depends on GPIO
	select ICM42670S_TRIGGER
endchoice

config ICM42670S_TRIGGER
	bool

config ICM42670S_THREAD_PRIORITY
	int "Thread priority"
	default 10
	help
	  Priority of thread used by the driver to handle interrupts.

config ICM42670S_THREAD_STACK_SIZE
	int "Thread stack size"
	default 1024
	help
	  Stack size of thread used by the driver to handle interrupts.

endif # ICM42670S
```

## drivers/sensor/icm45686/Kconfig
```kconfig
# ICM45686 Three-Axis Motion Tracking device configuration options
#
# Copyright (c) 2024 TDK Invensense
#
# SPDX-License-Identifier: Apache-2.0

menuconfig ICM45686
	bool "ICM45686 Three-Axis Motion Tracking Device"
	default y
	depends on DT_HAS_INVENSENSE_ICM45686_ENABLED
	select SPI
	help
	  Enable driver for ICM45686 I2C-based three-axis motion tracking device.

if ICM45686

choice ICM45686_TRIGGER_MODE
	prompt "Trigger mode"
	default ICM45686_TRIGGER_GLOBAL_THREAD
	help
	  Specify the type of triggering to be used by the driver.

config ICM45686_TRIGGER_NONE
	bool "No trigger"

config ICM45686_TRIGGER_GLOBAL_THREAD
	bool "Use global thread"
	depends on GPIO
	select ICM45686_TRIGGER

config ICM45686_TRIGGER_OWN_THREAD
	bool "Use own thread"
	depends on GPIO
	select ICM45686_TRIGGER

endchoice

config ICM45686_TRIGGER
	bool

config ICM45686_THREAD_PRIORITY
	int "Thread priority"
	depends on ICM45686_TRIGGER_OWN_THREAD
	default 10
	help
	  Priority of thread used by the driver to handle interrupts.

config ICM45686_THREAD_STACK_SIZE
	int "Thread stack size"
	depends on ICM45686_TRIGGER_OWN_THREAD
	default 1024
	help
	  Stack size of thread used by the driver to handle interrupts.

endif # ICM45686
```

## drivers/sensor/icp101xx/Kconfig
```kconfig
# ICP101xx High Accuracy, Low Power, Waterproof Barometric Pressure and Temperature Sensor option

# SPDX-License-Identifier: Apache-2.0

menuconfig ICP101XX
	bool "ICP101xx Barometric Pressure and Temperature Sensor"
	default y
	depends on DT_HAS_INVENSENSE_ICP101XX_ENABLED
	select I2C
	help
	  Enable driver for ICP101xx Barometric Pressure and Temperature Sensor.
```

## drivers/sensor/icp201xx/Kconfig
```kconfig
# ICP201xx High Accuracy, Low Power, Barometric Pressure and Temperature Sensor IC

# SPDX-License-Identifier: Apache-2.0

menuconfig ICP201XX
	bool "ICP201xx Barometric Pressure and Temperature Sensor"
	default y
	depends on DT_HAS_INVENSENSE_ICP201XX_ENABLED
	select I2C if $(dt_compat_on_bus,$(DT_COMPAT_INVENSENSE_ICP201XX),i2c)
	select SPI if $(dt_compat_on_bus,$(DT_COMPAT_INVENSENSE_ICP201XX),spi)
	help
	  Enable driver for ICP101xx Barometric Pressure and Temperature Sensor.

if ICP201XX
config ICP201XX_THREAD_PRIORITY
	int "Thread priority"
	default 10
	help
	  Priority of thread used by the driver to handle interrupts.

config ICP201XX_THREAD_STACK_SIZE
	int "Thread stack size"
	default 1024
	help
	  Stack size of thread used by the driver to handle interrupts.

endif # ICP201XX
```

## drivers/sensor/tdk/icm42670/Kconfig
```kconfig
# ICM42670-P ICM42670-S Six-Axis Motion Tracking device configuration options
#
# Copyright (c) 2023 TDK Invensense
# Copyright (c) 2022 Esco Medical ApS
# Copyright (c) 2020 TDK Invensense
# SPDX-License-Identifier: Apache-2.0

menuconfig ICM42670
	bool "ICM42670 6-Axis Motion Tracking Device"
	default y
	depends on DT_HAS_INVENSENSE_ICM42670_ENABLED
	select I2C if $(dt_compat_on_bus,$(DT_COMPAT_INVENSENSE_ICM42670),i2c)
	select SPI if $(dt_compat_on_bus,$(DT_COMPAT_INVENSENSE_ICM42670),spi)
	help
	  Enable driver for ICM42670 I2C-based or SPI-based Six-Axis Motion Tracking device.

if ICM42670

config ICM42670_APEX
	bool "ICM42670 APEX features"
	default n

choice APEX_FEATURES
	prompt "ICM42670 APEX features"
	depends on ICM42670_APEX
	default TDK_APEX_PEDOMETER
	help
	  Select APEX feature for ICM42670 sensor.
config TDK_APEX_PEDOMETER
	bool "Pedometer: Tracks step count"
config TDK_APEX_TILT
	bool "Tilt Detection: Detect the Tilt angle exceeds 35 degrees"
config TDK_APEX_SMD
	bool "Significant Motion Detector (SMD): Detects significant motion based on accelerometer data"
config TDK_APEX_WOM
	bool "Wake on Motion (WoM): Detects motion when accelerometer samples exceed a programmable threshold"
endchoice

choice ICM42670_TRIGGER_MODE
	prompt "Trigger mode"
	default ICM42670_TRIGGER_NONE
	help
	  Specify the type of triggering to be used by the driver.

config ICM42670_TRIGGER_NONE
	bool "No trigger"

config ICM42670_TRIGGER_GLOBAL_THREAD
	bool "Use global thread"
	depends on GPIO
	select ICM42670_TRIGGER

config ICM42670_TRIGGER_OWN_THREAD
	bool "Use own thread"
	depends on GPIO
	select ICM42670_TRIGGER

endchoice

config ICM42670_TRIGGER
	bool

config ICM42670_THREAD_PRIORITY
	int "Thread priority"
	depends on ICM42670_TRIGGER_OWN_THREAD
	default 10
	help
	  Priority of thread used by the driver to handle interrupts.

config ICM42670_THREAD_STACK_SIZE
	int "Thread stack size"
	depends on ICM42670_TRIGGER_OWN_THREAD
	default 1024
	help
	  Stack size of thread used by the driver to handle interrupts.

endif # ICM42670
```

## drivers/sensor/tdk/icm42x7x/Kconfig
```kconfig
# Six-Axis Motion Tracking device :
# ICM42670-P ICM42670-S ICM42671-P ICM42671-S 
# Three-Axis Motion Tracking device :
# ICM42370-P
# Configuration options :
#
# Copyright (c) 2024 TDK Invensense
# Copyright (c) 2022 Esco Medical ApS
# Copyright (c) 2020 TDK Invensense
# SPDX-License-Identifier: Apache-2.0

menuconfig ICM42X7X
	bool "ICM42X7X 6-Axis or 3-Axis Motion Tracking Device"
	default y
	depends on DT_HAS_INVENSENSE_ICM42X7X_ENABLED
	select I2C if $(dt_compat_on_bus,$(DT_COMPAT_INVENSENSE_ICM42X7X),i2c)
	select SPI if $(dt_compat_on_bus,$(DT_COMPAT_INVENSENSE_ICM42X7X),spi)
	help
	  Enable driver for ICM42X7X I2C-based or SPI-based Six-Axis or Three-Axis Motion Tracking device.

if ICM42X7X

config ICM42X7X_APEX
	bool "ICM42X7X APEX features"
	default n

choice APEX_FEATURES
	prompt "ICM42X7X APEX features"
	depends on ICM42X7X_APEX
	default TDK_APEX_PEDOMETER
	help
	  Select APEX feature for ICM42X7X sensor.
config TDK_APEX_PEDOMETER
	bool "Pedometer: Tracks step count"
config TDK_APEX_TILT
	bool "Tilt Detection: Detect the Tilt angle exceeds 35 degrees"
config TDK_APEX_SMD
	bool "Significant Motion Detector (SMD): Detects significant motion based on accelerometer data"
config TDK_APEX_WOM
	bool "Wake on Motion (WoM): Detects motion when accelerometer samples exceed a programmable threshold"
endchoice

choice ICM42X7X_TRIGGER_MODE
	prompt "Trigger mode"
	default ICM42X7X_TRIGGER_NONE
	help
	  Specify the type of triggering to be used by the driver.

config ICM42X7X_TRIGGER_NONE
	bool "No trigger"

config ICM42X7X_TRIGGER_GLOBAL_THREAD
	bool "Use global thread"
	depends on GPIO
	select ICM42X7X_TRIGGER

config ICM42X7X_TRIGGER_OWN_THREAD
	bool "Use own thread"
	depends on GPIO
	select ICM42X7X_TRIGGER

endchoice

config ICM42X7X_TRIGGER
	bool

config ICM42X7X_THREAD_PRIORITY
	int "Thread priority"
	depends on ICM42X7X_TRIGGER_OWN_THREAD
	default 10
	help
	  Priority of thread used by the driver to handle interrupts.

config ICM42X7X_THREAD_STACK_SIZE
	int "Thread stack size"
	depends on ICM42X7X_TRIGGER_OWN_THREAD
	default 1024
	help
	  Stack size of thread used by the driver to handle interrupts.

endif # ICM42X7X
```

## drivers/sensor/tdk/icm456xx/Kconfig
```kconfig
# ICM45686-P ICM45686-S Six-Axis Motion Tracking device configuration options
#
# Copyright (c) 2024 TDK Invensense
# Copyright (c) 2022 Esco Medical ApS
# Copyright (c) 2020 TDK Invensense
#
# SPDX-License-Identifier: Apache-2.0
config TDK_APEX
	bool

menuconfig ICM456XX
	bool "ICM45686 Six-Axis Motion Tracking Device"
	default y
	depends on ZEPHYR_HAL_TDK_MODULE
	select SPI if $(dt_compat_on_bus,$(DT_COMPAT_INVENSENSE_ICM45686),spi)
	select I2C if $(dt_compat_on_bus,$(DT_COMPAT_INVENSENSE_ICM45686),i2c)
	select TDK_APEX if $(dt_node_str_prop_equals,$(dt_nodelabel_path,icm45686),apex,pedometer) \
		|| $(dt_node_str_prop_equals,$(dt_nodelabel_path,icm45686),apex,tilt) \
		|| $(dt_node_str_prop_equals,$(dt_nodelabel_path,icm45686),apex,smd) \
		|| $(dt_node_str_prop_equals,$(dt_nodelabel_path,icm45686),apex,wom)
	select USE_EMD_ICM45686
	select SENSOR_ASYNC_API
	help
	  Enable driver for ICM456XX SPI-based or I2C-based Six-Axis or Three-Axis Motion Tracking device.

if ICM456XX

choice ICM456XX_TRIGGER_MODE
	prompt "Trigger mode"
	default ICM456XX_TRIGGER_NONE
	help
	  Specify the type of triggering to be used by the driver.

config ICM456XX_TRIGGER_NONE
	bool "No trigger"

config ICM456XX_TRIGGER_GLOBAL_THREAD
	bool "Use global thread"
	depends on GPIO
	depends on $(dt_compat_any_has_prop,$(DT_COMPAT_INVENSENSE_ICM45686),int-gpios)
	select ICM456XX_TRIGGER

config ICM456XX_TRIGGER_OWN_THREAD
	bool "Use own thread"
	depends on GPIO
	depends on $(dt_compat_any_has_prop,$(DT_COMPAT_INVENSENSE_ICM45686),int-gpios)
	select ICM456XX_TRIGGER

endchoice

config ICM456XX_TRIGGER
	bool

config ICM456XX_THREAD_PRIORITY
	int "Thread priority"
	depends on ICM456XX_TRIGGER_OWN_THREAD
	default 10
	help
	  Priority of thread used by the driver to handle interrupts.

config ICM456XX_THREAD_STACK_SIZE
	int "Thread stack size"
	depends on ICM456XX_TRIGGER_OWN_THREAD
	default 1024
	help
	  Stack size of thread used by the driver to handle interrupts.

endif # ICM456XX
```

## drivers/sensor/tdk/ict1531x/Kconfig
```kconfig
# Copyright (c) 2024 TDK Invensense

# ICT1531X high precision 3-axis electronic magnetometer sensor IC

# SPDX-License-Identifier: Apache-2.0
config ICT1531X
	bool "high precision 3-axis electronic magnetometer sensor"
	default y
	depends on DT_HAS_INVENSENSE_ICT1531X_ENABLED
	select I2C
  select ZEPHYR_HAL_TDK_MODULE
  select USE_EMD_ICT1531X
	help
	  Enable driver for ICT1531X high precision 3-axis electronic magnetometer sensor.
```
